## apps/examples/testcase/ostest/Kconfig
```kconfig
#
# For a description of the syntax of this configuration file,
# see the file kconfig-language.txt in the NuttX tools repository.
#

config TESTING_OSTEST
	bool "OS test example"
	default n
	---help---
		Enable the OS test example

if TESTING_OSTEST

config TESTING_OSTEST_ALL
	bool "All supported tests"
	default n
	select TESTING_OSTEST_ARGUMENT
	select TESTING_OSTEST_STDIO
	select TESTING_OSTEST_ENVIRON if !DISABLE_ENVIRON
	select TESTING_OSTEST_SETVBUF if STDIO_BUFFER_SIZE > 0
	select TESTING_OSTEST_DEV_NULL if DEV_NULL
	select TESTING_OSTEST_AIO if FS_AIO
	select TESTING_OSTEST_MULTIUSER if SCHED_USER_IDENTITY && LIBC_PASSWD_FILE
	select TESTING_OSTEST_FPU if ARCH_FPU && SCHED_WAITPID && BUILD_FLAT && !TESTING_OSTEST_FPUTESTDISABLE
	select TESTING_OSTEST_RESTART if !BUILD_KERNEL
	select TESTING_OSTEST_WAITPID if SCHED_WAITPID && !BUILD_KERNEL
	select TESTING_OSTEST_WQUEUE if !DISABLE_PTHREAD && SCHED_WORKQUEUE && BUILD_FLAT
	select TESTING_OSTEST_MUTEX if !DISABLE_PTHREAD
	select TESTING_OSTEST_RMUTEX if !DISABLE_PTHREAD && PTHREAD_MUTEX_TYPES
	select TESTING_OSTEST_SPECIFIC if !DISABLE_PTHREAD && NPTHREAD_KEYS > 0
	select TESTING_OSTEST_CANCEL if !DISABLE_PTHREAD
	select TESTING_OSTEST_ROBUST if !DISABLE_PTHREAD && !PTHREAD_MUTEX_UNSAFE
	select TESTING_OSTEST_SEM if !DISABLE_PTHREAD
	select TESTING_OSTEST_SEMTIMED if !DISABLE_PTHREAD
	select TESTING_OSTEST_NSEM if !DISABLE_PTHREAD && FS_NAMED_SEMAPHORES
	select TESTING_OSTEST_COND if !DISABLE_PTHREAD
	select TESTING_OSTEST_PTHREAD_EXIT if !DISABLE_PTHREAD && SCHED_WAITPID
	select TESTING_OSTEST_PTHREAD_RWLOCK if !DISABLE_PTHREAD
	select TESTING_OSTEST_PTHREAD_RWLOCK_CANCEL if !DISABLE_PTHREAD
	select TESTING_OSTEST_PTHREAD_CLEANUP if !DISABLE_PTHREAD && PTHREAD_CLEANUP
	select TESTING_OSTEST_TIMEDWAIT if !DISABLE_PTHREAD
	select TESTING_OSTEST_TIMEDMQUEUE if !DISABLE_PTHREAD && !DISABLE_MQUEUE
	select TESTING_OSTEST_SIGPROCMASK if !DISABLE_SIGNALS
	select TESTING_OSTEST_MQUEUE if !DISABLE_PTHREAD && !DISABLE_MQUEUE && !DISABLE_SIGNALS
	select TESTING_OSTEST_SUSPEND if !DISABLE_SIGNALS && SIG_SIGSTOP_ACTION && SIG_SIGKILL_ACTION && !BUILD_KERNEL
	select TESTING_OSTEST_SIGHAND if !DISABLE_SIGNALS
	select TESTING_OSTEST_SIGNEST if !DISABLE_PTHREAD && !DISABLE_SIGNALS
	select TESTING_OSTEST_POSIXTIMER if !DISABLE_POSIX_TIMERS && !DISABLE_SIGNALS
	select TESTING_OSTEST_SPINLOCK if BUILD_FLAT
	select TESTING_OSTEST_WDOG if BUILD_FLAT
	select TESTING_OSTEST_HRTIMER if BUILD_FLAT && HRTIMER
	select TESTING_OSTEST_SIGEV_THREAD if !DISABLE_POSIX_TIMERS && SIG_EVTHREAD
	select TESTING_OSTEST_ROUNDROBIN if !DISABLE_PTHREAD && RR_INTERVAL > 0
	select TESTING_OSTEST_SPORADIC if !DISABLE_PTHREAD && SCHED_SPORADIC
	select TESTING_OSTEST_SPORADIC2 if !DISABLE_PTHREAD && SCHED_SPORADIC
	select TESTING_OSTEST_BARRIER if !DISABLE_PTHREAD
	select TESTING_OSTEST_SETJMP if ARCH_SETJMP_H
	select TESTING_OSTEST_PRIOINHERIT if !DISABLE_PTHREAD && PRIORITY_INHERITANCE
	select TESTING_OSTEST_SCHEDLOCK if !DISABLE_PTHREAD
	select TESTING_OSTEST_SMP_CALL if SMP && BUILD_FLAT
	select TESTING_OSTEST_NXEVENT if SCHED_EVENTS && BUILD_FLAT
	select TESTING_OSTEST_PERF_GETTIME if ARCH_HAVE_PERF_EVENTS && ARCH_PERF_EVENTS && !ARCH_PERF_EVENTS_USER_ACCESS && BUILD_FLAT
	select TESTING_OSTEST_TLS if TLS_NELEM > 0
	select TESTING_OSTEST_SCHED_THREAD_LOCAL if SCHED_THREAD_LOCAL
	select TESTING_OSTEST_VFORK if ARCH_HAVE_VFORK && !ARCH_SIM
	select TESTING_OSTEST_FORK if ARCH_HAVE_FORK

config TESTING_OSTEST_ARGUMENT
	bool "Argument test"
	default n

config TESTING_OSTEST_STDIO
	bool "Standard I/O test"
	default n

config TESTING_OSTEST_ENVIRON
	bool "Environment variable test"
	default n
	depends on !DISABLE_ENVIRON

config TESTING_OSTEST_GETOPT
	bool "getopt test"
	default n

config TESTING_OSTEST_GETOPT_LONG
	bool "getopt_long test"
	default n

config TESTING_OSTEST_GETOPT_LONG_ONLY
	bool "getopt_long_only test"
	default n

config TESTING_OSTEST_LIBC_MEMMEM
	bool "memmem test"
	default n

config TESTING_OSTEST_TIMEDMUTEX
	bool "Pthread timed mutex test"
	default n
	depends on !DISABLE_PTHREAD

config TESTING_OSTEST_SETVBUF
	bool "setvbuf test"
	default n
	depends on STDIO_BUFFER_SIZE > 0

config TESTING_OSTEST_DEV_NULL
	bool "/dev/null test"
	default n
	depends on DEV_NULL

config TESTING_OSTEST_FPU
	bool "FPU test"
	default n
	depends on ARCH_FPU && SCHED_WAITPID && BUILD_FLAT
	depends on !TESTING_OSTEST_FPUTESTDISABLE

config TESTING_OSTEST_RESTART
	bool "Task restart test"
	default n
	depends on !BUILD_KERNEL

config TESTING_OSTEST_WAITPID
	bool "waitpid test"
	default n
	depends on SCHED_WAITPID && !BUILD_KERNEL

config TESTING_OSTEST_WQUEUE
	bool "Work queue test"
	default n
	depends on !DISABLE_PTHREAD && SCHED_WORKQUEUE && BUILD_FLAT

config TESTING_OSTEST_MUTEX
	bool "Pthread mutex test"
	default n
	depends on !DISABLE_PTHREAD

config TESTING_OSTEST_RMUTEX
	bool "Recursive mutex test"
	default n
	depends on !DISABLE_PTHREAD && PTHREAD_MUTEX_TYPES

config TESTING_OSTEST_SPECIFIC
	bool "Pthread-specific data test"
	default n
	depends on !DISABLE_PTHREAD && NPTHREAD_KEYS > 0

config TESTING_OSTEST_CANCEL
	bool "Pthread cancellation test"
	default n
	depends on !DISABLE_PTHREAD

config TESTING_OSTEST_ROBUST
	bool "Robust mutex test"
	default n
	depends on !DISABLE_PTHREAD && !PTHREAD_MUTEX_UNSAFE

config TESTING_OSTEST_SEM
	bool "Semaphore test"
	default n
	depends on !DISABLE_PTHREAD

config TESTING_OSTEST_SEMTIMED
	bool "Timed semaphore test"
	default n
	depends on !DISABLE_PTHREAD

config TESTING_OSTEST_NSEM
	bool "Named semaphore test"
	default n
	depends on !DISABLE_PTHREAD && FS_NAMED_SEMAPHORES

config TESTING_OSTEST_COND
	bool "Condition variable test"
	default n
	depends on !DISABLE_PTHREAD

config TESTING_OSTEST_PTHREAD_EXIT
	bool "Pthread exit test"
	default n
	depends on !DISABLE_PTHREAD && SCHED_WAITPID

config TESTING_OSTEST_PTHREAD_RWLOCK
	bool "Pthread read-write lock test"
	default n
	depends on !DISABLE_PTHREAD

config TESTING_OSTEST_PTHREAD_RWLOCK_CANCEL
	bool "Pthread read-write lock cancellation test"
	default n
	depends on !DISABLE_PTHREAD

config TESTING_OSTEST_PTHREAD_CLEANUP
	bool "Pthread cleanup test"
	default n
	depends on !DISABLE_PTHREAD && PTHREAD_CLEANUP

config TESTING_OSTEST_TIMEDWAIT
	bool "Condition variable timed wait test"
	default n
	depends on !DISABLE_PTHREAD

config TESTING_OSTEST_TIMEDMQUEUE
	bool "Timed message queue test"
	default n
	depends on !DISABLE_PTHREAD && !DISABLE_MQUEUE

config TESTING_OSTEST_SIGPROCMASK
	bool "Signal mask test"
	default n
	depends on !DISABLE_SIGNALS

config TESTING_OSTEST_MQUEUE
	bool "Message queue test"
	default n
	depends on !DISABLE_PTHREAD && !DISABLE_MQUEUE && !DISABLE_SIGNALS

config TESTING_OSTEST_SUSPEND
	bool "Signal suspend test"
	default n
	depends on !DISABLE_SIGNALS && SIG_SIGSTOP_ACTION && SIG_SIGKILL_ACTION
	depends on !BUILD_KERNEL

config TESTING_OSTEST_SIGHAND
	bool "Signal handler test"
	default n
	depends on !DISABLE_SIGNALS

config TESTING_OSTEST_SIGNEST
	bool "Nested signal handler test"
	default n
	depends on !DISABLE_PTHREAD && !DISABLE_SIGNALS

config TESTING_OSTEST_POSIXTIMER
	bool "POSIX timer test"
	default n
	depends on !DISABLE_POSIX_TIMERS && !DISABLE_SIGNALS

config TESTING_OSTEST_SPINLOCK
	bool "Spinlock test"
	default n
	depends on BUILD_FLAT

config TESTING_OSTEST_WDOG
	bool "Watchdog test"
	default n
	depends on BUILD_FLAT

config TESTING_OSTEST_HRTIMER
	bool "High-resolution timer test"
	default n
	depends on BUILD_FLAT && HRTIMER

config TESTING_OSTEST_SIGEV_THREAD
	bool "SIGEV_THREAD timer test"
	default n
	depends on !DISABLE_POSIX_TIMERS && SIG_EVTHREAD

config TESTING_OSTEST_ROUNDROBIN
	bool "Round-robin scheduler test"
	default n
	depends on !DISABLE_PTHREAD && RR_INTERVAL > 0

config TESTING_OSTEST_SPORADIC
	bool "Sporadic scheduler test"
	default n
	depends on !DISABLE_PTHREAD && SCHED_SPORADIC

config TESTING_OSTEST_SPORADIC2
	bool "Dual sporadic thread test"
	default n
	depends on !DISABLE_PTHREAD && SCHED_SPORADIC

config TESTING_OSTEST_BARRIER
	bool "Pthread barrier test"
	default n
	depends on !DISABLE_PTHREAD

config TESTING_OSTEST_SETJMP
	bool "setjmp test"
	default n
	depends on ARCH_SETJMP_H

config TESTING_OSTEST_PRIOINHERIT
	bool "Priority inheritance test"
	default n
	depends on !DISABLE_PTHREAD && PRIORITY_INHERITANCE

config TESTING_OSTEST_SCHEDLOCK
	bool "Scheduler lock test"
	default n
	depends on !DISABLE_PTHREAD

config TESTING_OSTEST_SMP_CALL
	bool "SMP call test"
	default n
	depends on SMP && BUILD_FLAT

config TESTING_OSTEST_NXEVENT
	bool "Scheduler event test"
	default n
	depends on SCHED_EVENTS && BUILD_FLAT

config TESTING_OSTEST_PERF_GETTIME
	bool "Performance event time test"
	default n
	depends on ARCH_HAVE_PERF_EVENTS && ARCH_PERF_EVENTS
	depends on !ARCH_PERF_EVENTS_USER_ACCESS && BUILD_FLAT

config TESTING_OSTEST_TLS
	bool "Task-local storage test"
	default n
	depends on TLS_NELEM > 0

config TESTING_OSTEST_SCHED_THREAD_LOCAL
	bool "Compiler thread-local storage test"
	default n
	depends on SCHED_THREAD_LOCAL

config TESTING_OSTEST_VFORK
	bool "vfork test"
	default n
	depends on ARCH_HAVE_VFORK && !ARCH_SIM

config TESTING_OSTEST_FORK
	bool "fork test"
	default n
	depends on ARCH_HAVE_FORK

config TESTING_OSTEST_LOOPS
	int "OS test loop"
	default 1
	---help---
		Used to control the number of executions of the test.  If undefined, the test
		executes one time.  If defined to be zero, the test runs forever.

config TESTING_OSTEST_STACKSIZE
	int "OS test stack size"
	default 8192
	---help---
		Size of the stack used to create the ostest task.  Default is 8192.

config TESTING_OSTEST_NBARRIER_THREADS
	int "Number of barrier threads"
	default 8
	depends on TESTING_OSTEST_BARRIER
	---help---
		Specifies the number of threads to create in the barrier test.  The default
		is 8 but a smaller number may be needed on systems without sufficient memory
		to start so many threads.

config TESTING_OSTEST_AIO
	bool "Asynchronous I/O Tests"
	default n
	depends on FS_AIO
	---help---
		Enables test of asynchronous I/O.  You must have a mounted, writable
		directory in place to use this test.

if TESTING_OSTEST_AIO

config TESTING_OSTEST_AIOPATH
	string "Scratch file path"
	default "/tmp"
	---help---
		This is the location of a directory in a mounted file system that
		the AIO test can write into.

endif

config TESTING_OSTEST_RR_RANGE
	int "Round-robin test - end of search range"
	default 30000
	range 1 32767
	depends on TESTING_OSTEST_ROUNDROBIN
	---help---
		During round-robin scheduling test two threads are created. Each of the threads
		searches for prime numbers in the configurable range, doing that configurable
		number of times.

		This value specifies the end of search range and together with number of runs
		allows to configure the length of this test - it should last at least a few
		tens of seconds. Allowed values [1; 32767], default 30000

config TESTING_OSTEST_RR_RUNS
	int "Round-robin test - number of runs"
	default 10
	range 1 32767
	depends on TESTING_OSTEST_ROUNDROBIN
	---help---
		During round-robin scheduling test two threads are created. Each of the threads
		searches for prime numbers in the configurable range, doing that configurable
		number of times.

		This value specifies the number of times the thread searches the range for
		prime numbers and together with end of search range allows to configure the
		length of this test - it should last at least a few tens of seconds. Allowed
		values [1; 32767], default 10

if ARCH_FPU && SCHED_WAITPID

config TESTING_OSTEST_FPUTESTDISABLE
	bool "Disable FPU test"
	default n

if TESTING_OSTEST_FPU

config TESTING_OSTEST_FPULOOPS
	int "Number of FPU test loops"
	default 16

config TESTING_OSTEST_FPUMSDELAY
	int "FPU test delay (MSec)"
	default 750

config TESTING_OSTEST_FPUPRIORITY
	int "FPU test thread priority"
	default 100

config TESTING_OSTEST_FPUSTACKSIZE
	int "FPU test thread stack size"
	default 8192

endif # TESTING_OSTEST_FPU
endif # ARCH_FPU && SCHED_WAITPID

config TESTING_OSTEST_WAITRESULT
	bool "Wait and return test result"
	default y
	depends on SCHED_WAITPID

config TESTING_OSTEST_POWEROFF
	bool "Terminate on test completion"
	default n
	depends on BOARDCTL_POWEROFF && TESTING_OSTEST_WAITRESULT

config TESTING_OSTEST_SPINLOCK_THREADS
	int "Number of spinlock test threads"
	default 2
	range 1 32
	depends on TESTING_OSTEST_SPINLOCK

config TESTING_OSTEST_MULTIUSER
	bool "Multi-user identity and permission tests"
	default n
	depends on SCHED_USER_IDENTITY
	depends on LIBC_PASSWD_FILE
	---help---
		Enable regression tests for UID/GID identity switching and file
		permission enforcement.  Individual sub-tests run only when the
		corresponding kernel options are enabled (for example pseudoFS
		permission checks require FS_PERMISSION and PSEUDOFS_FILE).

		The passwd lookup sub-test creates a temporary passwd file at
		CONFIG_LIBC_PASSWD_FILEPATH (default /tmp/ostest_passwd when this
		option is enabled).

config TEST_LOOP_SCALE
	int "Loop scale of spinlock test (N x 10,000)"
	default 100
	depends on TESTING_OSTEST_SPINLOCK

endif # TESTING_OSTEST
```
